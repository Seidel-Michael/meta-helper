## conf/layer.conf
```bitbake
# We have a conf and classes directory, append to BBPATH
BBPATH .= ":${LAYERDIR}"

# We have a recipes directory, add to BBFILES
BBFILES += "${LAYERDIR}/recipes*/*/*.bb ${LAYERDIR}/recipes*/*/*.bbappend"

BBFILE_COLLECTIONS += "meta-helper"
BBFILE_PATTERN_meta-helper:= "^${LAYERDIR}/"
BBFILE_PRIORITY_meta-helper = "10"

# This should only be incremented on significant changes that will
# cause compatibility issues with other layers
LAYERVERSION_meta-helper = "1"

LAYERDEPENDS_meta-helper = "core"

LAYERSERIES_COMPAT_meta-helper = "dunfell"
```
